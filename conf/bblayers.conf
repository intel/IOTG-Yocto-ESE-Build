## conf/bblayers.conf
```bitbake
# POKY_BBLAYERS_CONF_VERSION is increased each time build/conf/bblayers.conf
# changes incompatibly
POKY_BBLAYERS_CONF_VERSION = "2"

BBPATH = "${TOPDIR}"
BBFILES ?= ""
METALAYER_PREFIX = "intel-embedded-system-enabling/"

BBLAYERS ?= " \
  ${TOPDIR}/../${METALAYER_PREFIX}meta \
  ${TOPDIR}/../${METALAYER_PREFIX}meta-security \
  ${TOPDIR}/../${METALAYER_PREFIX}meta-security/meta-tpm \
  ${TOPDIR}/../${METALAYER_PREFIX}meta-openembedded/meta-oe \
  ${TOPDIR}/../${METALAYER_PREFIX}meta-openembedded/meta-filesystems \
  ${TOPDIR}/../${METALAYER_PREFIX}meta-openembedded/meta-perl \
  ${TOPDIR}/../${METALAYER_PREFIX}meta-openembedded/meta-python \
  ${TOPDIR}/../${METALAYER_PREFIX}meta-openembedded/meta-multimedia \
  ${TOPDIR}/../${METALAYER_PREFIX}meta-openembedded/meta-networking \
  ${TOPDIR}/../${METALAYER_PREFIX}meta-intel \
  ${TOPDIR}/../${METALAYER_PREFIX}meta-openvino \
  ${TOPDIR}/../${METALAYER_PREFIX}meta-mender/meta-mender-core \
  ${TOPDIR}/../${METALAYER_PREFIX}meta-virtualization \
  ${TOPDIR}/../${METALAYER_PREFIX}meta-clang \
  ${TOPDIR}/../${METALAYER_PREFIX}meta-dpdk \
  ${TOPDIR}/../${METALAYER_PREFIX}meta-qt5 \
  ${TOPDIR}/../${METALAYER_PREFIX}meta-intel-sgx \
  ${TOPDIR}/../${METALAYER_PREFIX}meta-${METALAYER_PREFIX}meta-intel-iot-bsp \
  ${TOPDIR}/../${METALAYER_PREFIX}meta-${METALAYER_PREFIX}meta-intel-distro \
  ${TOPDIR}/../${METALAYER_PREFIX}meta-${METALAYER_PREFIX}meta-intel-iot-main \
  "

include internal/layers.conf
```

## conf/local.conf
```bitbake
#
# This file is your local configuration file and is where all local user settings
# are placed. The comments in this file give some guide to the options a new user
# to the system might want to change but pretty much any configuration option can
# be set in this file. More adventurous users can look at local.conf.extended
# which contains other examples of configuration which can be placed in this file
# but new users likely won't need any of them initially.
#
# Lines starting with the '#' character are commented out and in some cases the
# default values are provided as comments to show people example syntax. Enabling
# the option is a question of removing the # character and making any change to the
# variable as required.

BBMULTICONFIG = "x86 x86-rt x86-skylake x86-musl x86-minimal x86-minimal-netboot x86-minimal-provisioning x86-qemu_host"

# Machine Selection
MACHINE ??= "intel-corei7-64"
# Take note that as we are building 3rd party ingredient.
# We need the LICENSE_FLAGS below.
LICENSE_FLAGS_WHITELIST += "commercial"

# Multi-lib support is turned off by default
# To enable support, uncomment the below 4 lines
# and add 32-bit libraries with IMAGE_INSTALL
#require conf/multilib.conf
#DEFAULTTUNE = "corei7-64"
#MULTILIBS = "multilib:lib32"
#DEFAULTTUNE_virtclass-multilib-lib32 = "corei7-32"

# Use /lib64 even if not multilib
require conf/multilib.conf
MULTILIBS = ""

DISTRO_FEATURES_append = " virtualization"

#
# Additional image features
#
# The following is a list of additional classes to use when building images which
# enable extra features. Some available options which can be included in this variable
# are:
#   - 'buildstats' collect build statistics
#   - 'image-mklibs' to reduce shared library files size for an image
#   - 'image-prelink' in order to prelink the filesystem image
#   - 'image-swab' to perform host system intrusion detection
# NOTE: if listing mklibs & prelink both, then make sure mklibs is before prelink
# NOTE: mklibs also needs to be explicitly enabled for a given image, see local.conf.extended
# image-prelink disabled for now due to issues with IFUNC symbol relocation
USER_CLASSES ?= "buildstats image-mklibs"

# Where to place downloads
#
# During a first build the system will download many different source code tarballs
# from various upstream projects. This can take a while, particularly if your network
# connection is slow. These are all stored in DL_DIR. When wiping and rebuilding you
# can preserve this directory to speed up this part of subsequent builds. This directory
# is safe to share between multiple builds on the same machine too.
#
# The default is a downloads directory under TOPDIR which is the build directory.
#
#DL_DIR ?= "${TOPDIR}/downloads"

#
# Where to place shared-state files
#
# BitBake has the capability to accelerate builds based on previously built output.
# This is done using "shared state" files which can be thought of as cache objects
# and this option determines where those files are placed.
#
# You can wipe out TMPDIR leaving this directory intact and the build would regenerate
# from these files if no changes were made to the configuration. If changes were made
# to the configuration, only shared state files where the state was still valid would
# be used (done using checksums).
#
# The default is a sstate-cache directory under TOPDIR.
#
#SSTATE_DIR ?= "${TOPDIR}/sstate-cache"

#
# Where to place the build output
#
# This option specifies where the bulk of the building work should be done and
# where BitBake should place its temporary files and output. Keep in mind that
# this includes the extraction and compilation of many applications and the toolchain
# which can use Gigabytes of hard disk space.
#
# The default is a tmp directory under TOPDIR.
#
#TMPDIR = "${TOPDIR}/tmp"

#
# Default policy config
#
# The distribution setting controls which policy settings are used as defaults.
# The default value is fine for general Yocto project use, at least initially.
# Ultimately when creating custom policy, people will likely end up subclassing
# these defaults.
# For further details on ardia distro, see meta-ardia/README.
DISTRO ?= "intel-embedded-system-enabling"

#
# Package Management configuration
#
# This variable lists which packaging formats to enable. Multiple package backends
# can be enabled at once and the first item listed in the variable will be used
# to generate the root filesystems.
# Options are:
#  - 'package_deb' for debian style deb files
#  - 'package_ipk' for ipk files are used by opkg (a debian style embedded package manager)
#  - 'package_rpm' for rpm style packages
# E.g.: PACKAGE_CLASSES ?= "package_rpm package_deb package_ipk"
# We default to rpm:
PACKAGE_CLASSES ?= "package_rpm"

#
# SDK target architecture
#
# This variable specifies the architecture to build SDK items for and means
# you can build the SDK packages for architectures other than the machine you are
# running the build on (i.e. building i686 packages on an x86_64 host).
# Supported values are i686 and x86_64
SDKMACHINE ?= "x86_64"

#
# Extra image configuration defaults
#
# The EXTRA_IMAGE_FEATURES variable allows extra packages to be added to the generated
# images. Some of these options are added to certain image types automatically. The
# variable can contain the following options:
#  "dbg-pkgs"       - add -dbg packages for all installed packages
#                     (adds symbol information for debugging/profiling)
#  "dev-pkgs"       - add -dev packages for all installed packages
#                     (useful if you want to develop against libs in the image)
#  "ptest-pkgs"     - add -ptest packages for all ptest-enabled packages
#                     (useful if you want to run the package test suites)
#  "tools-sdk"      - add development tools (gcc, make, pkgconfig etc.)
#  "tools-debug"    - add debugging tools (gdb, strace)
#  "eclipse-debug"  - add Eclipse remote debugging support
#  "tools-profile"  - add profiling tools (oprofile, lttng, valgrind)
#  "tools-testapps" - add useful testing tools (ts_print, aplay, arecord etc.)
#  "debug-tweaks"   - make an image suitable for development
#                     e.g. ssh root access has a blank password
# There are other application targets that can be used here too, see
# meta/classes/image.bbclass and meta/classes/core-image.bbclass for more details.
# We default to enabling the debugging tweaks.
# EXTRA_IMAGE_FEATURES ?= "debug-tweaks"

#
# Runtime testing of images
#
# The build system can test booting virtual machine images under qemu (an emulator)
# after any root filesystems are created and run tests against those images. To
# enable this uncomment this line. See classes/testimage(-auto).bbclass for
# further details.
#TEST_IMAGE = "1"
#
# Interactive shell configuration
#
# Under certain circumstances the system may need input from you and to do this it
# can launch an interactive shell. It needs to do this since the build is
# multithreaded and needs to be able to handle the case where more than one parallel
# process may require the user's attention. The default is iterate over the available
# terminal types to find one that works.
#
# Examples of the occasions this may happen are when resolving patches which cannot
# be applied, to use the devshell or the kernel menuconfig
#
# Supported values are auto, gnome, xfce, rxvt, screen, konsole (KDE 3.x only), none
# Note: currently, Konsole support only works for KDE 3.x due to the way
# newer Konsole versions behave
#OE_TERMINAL = "auto"
# By default disable interactive patch resolution (tasks will just fail instead):
PATCHRESOLVE = "noop"

#
# Disk Space Monitoring during the build
#
# Monitor the disk space during the build. If there is less that 1GB of space or less
# than 100K inodes in any key build location (TMPDIR, DL_DIR, SSTATE_DIR), gracefully
# shutdown the build. If there is less that 100MB or 1K inodes, perform a hard abort
# of the build. The reason for this is that running completely out of space can corrupt
# files and damages the build in ways which may not be easily recoverable.
# It's necesary to monitor /tmp, if there is no space left the build will fail
# with very exotic errors.
BB_DISKMON_DIRS = "\
    STOPTASKS,${TMPDIR},1G,100K \
    STOPTASKS,${DL_DIR},1G,100K \
    STOPTASKS,${SSTATE_DIR},1G,100K \
    STOPTASKS,/tmp,100M,100K \
    ABORT,${TMPDIR},100M,1K \
    ABORT,${DL_DIR},100M,1K \
    ABORT,${SSTATE_DIR},100M,1K \
    ABORT,/tmp,10M,1K"

#
# Shared-state files from other locations
#
# As mentioned above, shared state files are prebuilt cache data objects which can
# used to accelerate build time. This variable can be used to configure the system
# to search other mirror locations for these objects before it builds the data itself.
#
# This can be a filesystem directory, or a remote url such as http or ftp. These
# would contain the sstate-cache results from previous builds (possibly from other
# machines). This variable works like fetcher MIRRORS/PREMIRRORS and points to the
# cache locations to check for the shared objects.
# NOTE: if the mirror uses the same structure as SSTATE_DIR, you need to add PATH
# at the end as shown in the examples below. This will be substituted with the
# correct path within the directory structure.
#SSTATE_MIRRORS ?= "\
#file://.* http://172.30.109.231/glenview/sstate/PATH;downloadfilename=PATH"
#file://.* http://someserver.tld/share/sstate/PATH;downloadfilename=PATH \n \
#file://.* file:///some/local/dir/sstate/PATH"


#
# Qemu configuration
#
# By default qemu will build with a builtin VNC server where graphical output can be
# seen. The two lines below enable the SDL backend too. By default libsdl-native will
# be built, if you want to use your host's libSDL instead of the minimal libsdl built
# by libsdl-native then uncomment the ASSUME_PROVIDED line below.
#PACKAGECONFIG_append_pn-qemu-native = " sdl"
#PACKAGECONFIG_append_pn-nativesdk-qemu = " sdl"
#ASSUME_PROVIDED += "libsdl-native"

# CONF_VERSION is increased each time build/conf/ changes incompatibly and is used to
# track the version of this file when it was generated. This can safely be ignored if
# this doesn't mean anything to you.
CONF_VERSION = "1"

# enable gcc security flags and optimizations
require conf/distro/include/security_flags.inc
EXTRA_OECONF_BASE_append = " --enable-default-pie --enable-default-ssp --enable-host-shared"
EXTRA_OECONF_BASE_append_x86 = " --enable-cld --enable-cet"
EXTRA_OECONF_BASE_append_x86-64 = " --enable-cld --enable-cet"
EXTRA_OECONF_BASE_append_libc-glibc = " --enable-gnu-unique-object --enable-vtable-verify"
EXTRA_OECONF_append_x86-64_pn-glibc = " --enable-static-pie --enable-cet"
RUNTIMETARGET_append_pn-gcc-runtime_libc-glibc = " libvtv"
CONFIGUREOPTS_append_pn-musl = " --enable-optimize=size"

# Want newer kernel-libc-headers with ptp uapi header patches
PREFERRED_VERSION_linux-libc-headers = "5.4%"

# Remove unneeded applciations
PACKAGECONFIG_remove_pn-alsa-tools = "echomixer envy24control rmedigicontrol"
PACKAGECONFIG_remove_pn-gstreamer1.0-plugins-good = "speex"
GSTEXAMPLES = ""
RDEPENDS_packagegroup-meta-oe-multimedia_remove = "yavta"
RDEPENDS_packagegroup-core-x11-utils_remove = "xinput-calibrator"
RDEPENDS_packagegroup-base-ext2_remove = "hdparm"
RDEPENDS_packagegroup-core-full-cmdline-extended_remove = "iputils"
RDEPENDS_packagegroup-core-x11-sato-base_remove = "matchbox-config-gtk settings-daemon"
RDEPENDS_packagegroup-core-x11-sato-apps_remove = "l3afpad"
RDEPENDS_packagegroup-base-serial_remove = "lrzsz"
RDEPENDS_packagegroup-core-tools-testapps_remove = "blktool lrzsz"
RDEPENDS_packagegroup-self-hosted-extended_remove = "lrzsz settings-daemon"
DEPENDS_remove_pn-perf = "libnewt"
MACHINE_FEATURES_remove_pn-matchbox-panel-2 = "acpi"
PACKAGECONFIG_remove_pn-iproute2 = "tipc"
PACKAGECONFIG_remove = "tcp-wrappers"
EXTRA_OECONF_remove_pn-matchbox-panel-2 = "--enable-startup-notification"
EXTRA_OECONF_append_pn-matchbox-panel-2 = " --disable-startup-notification"
DEPENDS_remove_pn-matchbox-panel-2 = "startup-notification"
EXTRA_OECONF_remove_pn-matchbox-desktop = "--enable-startup-notification"
EXTRA_OECONF_append_pn-matchbox-desktop = " --disable-startup-notification"
DEPENDS_remove_pn-matchbox-desktop = "startup-notification"
DEPENDS_remove_pn-matchbox-wm = "startup-notification"
EXTRA_OECONF_remove_pn-matchbox-wm = "--enable-startup-notification"
EXTRA_OECONF_append_pn-matchbox-wm = " --disable-startup-notification"
NETWORK_MANAGER = "connman"
FILEMANAGER = ""
PTEST_ENABLED_pn-util-linux = ""
PTEST_ENABLED_pn-openssh = ""
PACKAGECONFIG_remove_pn-vim = "gtkgui"
BAD_RECOMMENDATIONS_append = " rng-tools"
RRECOMMENDS_openssh-sshd_remove = "rng-tools"
PACKAGECONFIG_remove_pn-apparmor = "perl"

# fix grub-native vs grub-efi-native conflict
PREFERRED_PROVIDER_grub-efi-native = "grub-native"
PREFERRED_PROVIDER_grub-efi = "grub-efi"

# kernel 4.15 or later should not be using CRDA
# https://git.kernel.org/pub/scm/linux/kernel/git/mcgrof/crda.git/tree/README
RDEPENDS_packagegroup-base-wifi_remove = "wireless-regdb-static"
RDEPENDS_packagegroup-base-wifi_append = " wireless-regdb"

# OVMF Secureboot support
PACKAGECONFIG_append_pn-ovmf = " secureboot"

# internal content
include ${TOPDIR}/conf/internal/internal.inc
PTCM_INSTALL ?= "0"
```
